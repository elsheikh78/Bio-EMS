## firmware/site-controller-esp32s3/main/Kconfig.projbuild
```kconfig
menu "BIO-EMS W5500 bench wiring"
config BIOEMS_ETH_MOSI
    int "W5500 MOSI GPIO"
    default 11
config BIOEMS_ETH_MISO
    int "W5500 MISO GPIO"
    default 13
config BIOEMS_ETH_SCLK
    int "W5500 SCLK GPIO"
    default 12
config BIOEMS_ETH_CS
    int "W5500 chip select GPIO"
    default 10
endmenu

menu "BIO-EMS RTC and 2G bench interfaces"
config BIOEMS_RTC_ENABLED
    bool "Enable DS3231 UTC clock"
    default y
config BIOEMS_RTC_SDA
    int "DS3231 SDA GPIO"
    default 8
config BIOEMS_RTC_SCL
    int "DS3231 SCL GPIO"
    default 9
config BIOEMS_GSM_ENABLED
    bool "Enable SIM800L bench diagnostics and explicit SMS command"
    default y
config BIOEMS_GSM_TX
    int "SIM800L UART2 TX GPIO (through divider)"
    default 14
config BIOEMS_GSM_RX
    int "SIM800L UART2 RX GPIO (through NPN inverter)"
    default 21
config BIOEMS_GSM_RX_INVERTED
    bool "Invert RX for the specified external NPN circuit"
    default y
endmenu

menu "BIO-EMS offline SD storage"
config BIOEMS_SD_ENABLED
    bool "Enable SD store and forward (requires wired card)"
    default y
config BIOEMS_SD_MOSI
    int "SD MOSI GPIO (SPI3)"
    default 4
config BIOEMS_SD_MISO
    int "SD MISO GPIO (SPI3)"
    default 5
config BIOEMS_SD_SCLK
    int "SD SCLK GPIO (SPI3)"
    default 6
config BIOEMS_SD_CS
    int "SD CS GPIO (SPI3)"
    default 7
config BIOEMS_SD_QUEUE_RECORDS
    int "Maximum queued four-channel samples"
    range 1 20000
    default 20000
endmenu

menu "BIO-EMS production acceptance policy"
config BIOEMS_REQUIRE_PRODUCTION_SECURITY
    bool "Refuse startup without hardware secure boot and flash encryption"
    default n
    help
        Fails closed unless both hardware protections are already enabled.
        This option does not provision keys or burn eFuses. Do not treat it as
        manufacturing qualification or use it on ordinary pilot bench boards.
endmenu

menu "BIO-EMS designated-board recovery"
config BIOEMS_USB_AB_MAINTENANCE
    bool "Enable USB inactive-slot application update and rollback"
    default n
    depends on BOOTLOADER_APP_ROLLBACK_ENABLE
    help
        Requires the separately qualified custom two-slot partition layout.
        Never repartition a field pilot through ordinary Tester flashing.
config BIOEMS_UPDATE_CONFIRM_SECONDS
    int "First-boot confirmation deadline in seconds"
    range 30 600
    default 180
    depends on BIOEMS_USB_AB_MAINTENANCE
endmenu

menu "BIO-EMS power supervision (unwired inputs remain unknown)"
config BIOEMS_MAINS_GOOD_GPIO
    int "Isolated low-voltage mains-good input GPIO (-1 disables)"
    range -1 48
    default -1
config BIOEMS_BATTERY_LOW_GPIO
    int "Battery-low digital input GPIO (-1 disables)"
    range -1 48
    default -1
config BIOEMS_POWER_INPUT_ACTIVE_LOW
    bool "Power supervision inputs are active low"
    default n
endmenu
```
